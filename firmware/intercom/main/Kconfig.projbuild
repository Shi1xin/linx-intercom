## firmware/intercom/main/Kconfig.projbuild
```kconfig
menu "Intercom Configuration"

    config INTERCOM_WIFI_SSID
        string "Wi-Fi SSID"
        default "YOUR_SSID"
        help
            Wi-Fi STA ssid. Override at build time for the target network.

    config INTERCOM_WIFI_PASSWORD
        string "Wi-Fi Password"
        default "YOUR_PASSWORD"
        help
            Wi-Fi STA password.

    config INTERCOM_CTRL_URL
        string "Control WebSocket URL"
        default "ws://192.0.2.1:8090/ws"
        help
            Control service endpoint, e.g. ws://<host>:8090/ws

    config INTERCOM_DEVICE_TOKEN
        string "Device token sent in hello"
        default "dev"

    config INTERCOM_TURN_URL
        string "TURN/STUN server URL (empty = host candidates only)"
        default ""
        help
            ICE server URL passed to esp_peer, e.g. turn:host:3478?transport=udp
            or stun:host:3478. Leave empty to use host candidates only.

    config INTERCOM_TURN_USER
        string "TURN username"
        default "intercom"

    config INTERCOM_TURN_PASS
        string "TURN password"
        default ""

    config INTERCOM_CMD_TARGET_KIND
        string "Command recognition stub join target kind"
        default "room_name"
        help
            Placeholder command recognizer emits a join with this target kind:
            nfc | device | invite | room_name

    config INTERCOM_CMD_TARGET_ARG
        string "Command recognition stub join target argument"
        default "一号房"
        help
            Argument for the stub join target (room name / invite code / entry id).

    config INTERCOM_LINX_ENABLE
        bool "Connect to the Linx platform (default conversation channel)"
        default y

    config INTERCOM_LINX_OTA_URL
        string "Linx OTA gateway URL"
        default "https://xrobo.qiniuapi.com/v1/ota/"

    config INTERCOM_LINX_DEVICE_ID
        string "Platform Device-Id override (empty = Wi-Fi MAC)"
        default ""
        help
            Device identity presented to OTA/WebSocket headers. Leave empty to
            use the Wi-Fi STA MAC.

    config INTERCOM_LINX_CLIENT_ID
        string "Platform Client-Id override (empty = generated uuid in NVS)"
        default ""

    config INTERCOM_LINX_BOARD_TYPE
        string "Board type reported to OTA"
        default "bread-compact-wifi"

    config INTERCOM_LINX_SELFTEST_TEXT
        string "listen.detect text sent once after MCP tools/list (empty = off)"
        default ""
        help
            Headless test hook: simulates a spoken command. Emitted once per
            session ~1 s after the platform finishes tools/list.

    config INTERCOM_SPEAKER_ENABLE
        bool "Enable speaker playback (set n for silent bench tests)"
        default y

    config INTERCOM_WAKE_SELFTEST
        bool "Inject a canned wake utterance into the detector 8 s after boot"
        default n
        help
            Bench self-test: feeds a compiled-in 16 kHz 'ni hao xiao zhi'
            sample through the normal AFE feed/fetch path once per boot.
            Verifies model load + pipeline without any acoustic source.

    config INTERCOM_WAKE_PCM_TRACE
        bool "Keep a bench-only PCM input ring and export snapshots on unmute"
        depends on SPIRAM
        default n
        help
            Keeps the last eight seconds of mono 16 kHz AFE input in PSRAM.
            An unmute transition requests a snapshot uploaded by a low-priority
            task. Use a trusted local HTTP receiver for acoustic diagnostics;
            when the HTTP upload fails the snapshot falls back to an indexed,
            SHA-verified console dump.

    config INTERCOM_WAKE_PCM_TRACE_URL
        string "Trusted local PCM trace receiver HTTP URL"
        depends on INTERCOM_WAKE_PCM_TRACE
        default ""

    config INTERCOM_WAKE_PCM_TRACE_TOKEN
        string "PCM trace receiver bearer token"
        depends on INTERCOM_WAKE_PCM_TRACE
        default ""

endmenu
```

## firmware/intercom/sdkconfig.defaults.esp32s3
```kconfig
# ESP32-S3 N16R8: 8MB octal PSRAM @ 80MHz
CONFIG_SPIRAM=y
CONFIG_SPIRAM_MODE_OCT=y
CONFIG_SPIRAM_SPEED_80M=y
CONFIG_SPIRAM_MALLOC_ALWAYSINTERNAL=512
CONFIG_SPIRAM_MALLOC_RESERVE_INTERNAL=65536
CONFIG_SPIRAM_MEMTEST=n
CONFIG_SPIRAM_USE_MALLOC=y
CONFIG_SPIRAM_MALLOC_ALWAYSINTERNAL=512

CONFIG_ESP32S3_INSTRUCTION_CACHE_32KB=y
CONFIG_ESP32S3_DATA_CACHE_64KB=y
CONFIG_ESP32S3_DATA_CACHE_LINE_64B=y

# WakeNet: 你好小智
CONFIG_SR_WN_WN9S_NIHAOXIAOZHI=y
```
